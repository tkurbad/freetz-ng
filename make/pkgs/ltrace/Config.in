## make/pkgs/uvncrepeater/Config.in
```kconfig
config FREETZ_PACKAGE_UVNCREPEATER
	bool "UltraVNC Repeater 014 - DEPRECATED"
	default n
	help
		UltraVNC Repeater has two unique functions:
		Mode 1:
		Allows for connection to multiple servers (in listen mode), using only
		one port. All connection data flows through the repeater, allowing
		connection to multiple servers through a single port forward or tunnel.
		Mode 2: 
		Allows both a Viewer and Server to connect together using the repeater
		as a PROXY. All connection data flows through the repeater, allowing
		both the server and viewer to be behind firewalls or routers.
```

## make/pkgs/vlmcsd/Config.in
```kconfig
config FREETZ_PACKAGE_VLMCSD
	bool "VLMCSD svn1113"
	select FREETZ_PACKAGE_VLMCSD_vlmcsd if !FREETZ_PACKAGE_VLMCSD_vlmcs
	default n
	help
		vlmcsd is a fully Microsoft compatible KMS server hat provides
		product activation services to clients.
		It is designed to run on POSIX compatible operating systens.
		Only requirements are a basic C library with a BSD-style
		sockets API and either fork(2) or pthreads(7). That allows it
		to run on most embedded systems like routers, NASes, etc.

if FREETZ_PACKAGE_VLMCSD

	config FREETZ_PACKAGE_VLMCSD_vlmcs
		bool "vlmcs (binary only)"
		default n
		help
			Client binary only.

	config FREETZ_PACKAGE_VLMCSD_vlmcsd
		bool "vlmcsd"
		default n
		help
			Server with webif.

endif # FREETZ_PACKAGE_VLMCSD
```

## make/pkgs/vpnc/Config.in
```kconfig
config FREETZ_PACKAGE_VPNC
	bool "Vpnc 0.5.3 - DEPRECATED"
	select FREETZ_LIB_libgpg_error
	select FREETZ_LIB_libgcrypt
	default n
	help
		Cisco IPSec VPN Client

if FREETZ_PACKAGE_VPNC

	config FREETZ_PACKAGE_VPNC_WITH_HYBRID_AUTH
		bool "Hybrid auth"
		select FREETZ_LIB_libcrypto
		default n

	config FREETZ_PACKAGE_VPNC_NAT_SUPPORT
		bool "NAT support"
		depends on FREETZ_PACKAGE_IPTABLES_IS_SELECTABLE
		select FREETZ_PACKAGE_IPTABLES
		default n
		help
			Enable NAT support for VPNC. This requires iptables!

endif # FREETZ_PACKAGE_VPNC
```

## make/pkgs/whois/Config.in
```kconfig
config FREETZ_PACKAGE_WHOIS
	bool "Whois 5.5.22 (binary only)"
	default n
	select FREETZ_LIB_libidn
	help
		Whois - client for the whois directory service.
```

## make/pkgs/xrelayd/Config.in
```kconfig
config FREETZ_PACKAGE_XRELAYD
	bool "Xrelayd 0.2.1pre2 - DEPRECATED"
	select FREETZ_LIB_libpolarssl12 if ! FREETZ_PACKAGE_XRELAYD_STATIC
	default n
	help
		SSL tunnel based on PolarSSL. Xrelayd is a stripped down version of
		stunnel based on PolarSSL library. Essentially, this package makes your
		router's websrv or httpd SSL-enabled, offering you the option of remote
		configuration via WWW or secure remote use of features like Rudi-Shell.

if FREETZ_PACKAGE_XRELAYD

	config FREETZ_PACKAGE_XRELAYD_GENSTUFF
		bool "With Key-/Cert-Generation"
		select FREETZ_LIB_libpolarssl12_WITH_GENRSA
		default n
		help
			Include support for private key and x509 certificate generation.

	config FREETZ_PACKAGE_XRELAYD_STATIC
		bool "Create semistatic binary (link in polarssl library only)"
		default n
		help
			Eliminate run-time dependency on polarssl by linking it statically.

	config FREETZ_PACKAGE_XRELAYD_STATIC_FULL
		bool "Create completely static binary (link in all libraries)"
		select FREETZ_PACKAGE_XRELAYD_STATIC
		default n
		help
			Create statically linked binary.

endif # FREETZ_PACKAGE_XRELAYD
```

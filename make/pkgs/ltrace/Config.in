## make/pkgs/ltrace/Config.in
```kconfig
config FREETZ_PACKAGE_LTRACE
	bool "ltrace 0.7.3-git/0.8.1 (binary only)"
	default n
	depends on FREETZ_TARGET_GCC_4_7_MIN
	depends on !(FREETZ_TARGET_ARCH_ARM && FREETZ_TARGET_ARCH_BE && FREETZ_TARGET_BITS_32)  # no armeb, feel free to fix
	select FREETZ_LIB_libelf
	help
		ltrace - library call tracer

		ltrace is a debugging tool, similar to strace, but it traces library
		calls instead of system calls.

if FREETZ_PACKAGE_LTRACE

	choice
		prompt "Version"
			default FREETZ_PACKAGE_LTRACE_VERSION_CURRENT

		config FREETZ_PACKAGE_LTRACE_VERSION_ABANDON
			bool "0.7.3-git"
			depends on !(FREETZ_SEPARATE_AVM_UCLIBC && !FREETZ_KERNEL_VERSION_2)

		config FREETZ_PACKAGE_LTRACE_VERSION_CURRENT
			bool "0.8.1"
			depends on  (FREETZ_SEPARATE_AVM_UCLIBC && !FREETZ_KERNEL_VERSION_2)

	endchoice

endif # FREETZ_PACKAGE_LTRACE
```

## make/pkgs/minisatip/Config.in
```kconfig
config FREETZ_PACKAGE_MINISATIP
	bool "minisatip 1.0.4/1.3.6 (binary only) - DEPRECATED"
	default n
	depends on !FREETZ_TARGET_ARCH_X86
	select FREETZ_LIB_libpthread     if FREETZ_TARGET_UCLIBC_HAS_multiple_libs
	select FREETZ_LIB_librt          if FREETZ_TARGET_UCLIBC_HAS_multiple_libs
	help
		Minisatip is a multi-threaded satip server version 1.2 that
		runs under Linux and it was tested with DVB-S, DVB-S2,
		DVB-T, DVB-T2, DVB-C, DVB-C2, ATSC and ISDB-T cards.

if FREETZ_PACKAGE_MINISATIP

	choice
		prompt "Version"
			default FREETZ_PACKAGE_MINISATIP_VERSION_CURRENT

		config FREETZ_PACKAGE_MINISATIP_VERSION_ABANDON
			bool "1.0.4"
			depends on (FREETZ_KERNEL_VERSION_2_6_39_MAX && !FREETZ_KERNEL_VERSION_2_6_39_4)

		config FREETZ_PACKAGE_MINISATIP_VERSION_CURRENT
			bool "1.3.6"
			depends on !(FREETZ_KERNEL_VERSION_2_6_39_MAX && !FREETZ_KERNEL_VERSION_2_6_39_4)

	endchoice

	config FREETZ_PACKAGE_MINISATIP_HTML
		bool "With html files"
		default y
		help
			Includes the document-root for the integrated web
			server in /usr/share/minisatip/html/ directory.

	config FREETZ_PACKAGE_MINISATIP_LINUXDVB
		bool "Enable linux DVB"
		default y

	config FREETZ_PACKAGE_MINISATIP_SATIPC
		bool "Enable SAT>IP client"
		default y

	config FREETZ_PACKAGE_MINISATIP_DVBAPI
		bool "Enable DVBAPI"
		default y

	config FREETZ_PACKAGE_MINISATIP_DVBCA
		bool "Enable Common Interface"
		default n
		depends on FREETZ_PACKAGE_MINISATIP_VERSION_CURRENT
		select FREETZ_LIB_libcrypto
		select FREETZ_LIB_libdl          if FREETZ_TARGET_UCLIBC_HAS_multiple_libs
		help
			This option need Openssl.

	config FREETZ_PACKAGE_MINISATIP_DVBAES
		bool "Enable DVB/AES"
		default n
		depends on FREETZ_PACKAGE_MINISATIP_VERSION_ABANDON
		select FREETZ_LIB_libcrypto
		select FREETZ_LIB_libdl          if FREETZ_TARGET_UCLIBC_HAS_multiple_libs
		select FREETZ_LIB_libz
		help
			This option need Openssl and zlib.

	config FREETZ_PACKAGE_MINISATIP_DVBCSA
		bool "Enable DVB/CSA"
		default n
		select FREETZ_LIB_libdvbcsa
		help
			This option need libdvbcsa.

endif # FREETZ_PACKAGE_MINISATIP
```

## make/pkgs/nhipt/Config.in
```kconfig
config FREETZ_PACKAGE_NHIPT
	bool "NHIPT Iptables CGI 0.8.3a - DEPRECATED"
	default n
	depends on FREETZ_PACKAGE_IPTABLES
	select FREETZ_PACKAGE_IPTABLES_STANDARD_MODULES
	help
		New Iptables configuration interface.
```

## make/pkgs/pcp/Config.in
```kconfig
config FREETZ_PACKAGE_PCP
	bool "PCP client 1c783fb (binary only)"
	default n
	help
		PCP client library implements client side of PCP (RFC 6887)
		and NATPMP (RFC 6886) protocols. Switch to NATPMP is done 
		automatically by version negotiation. This library enables any
		network application to manage network edge device (e.g. to
		create NAT mapping or ask router for specific flow treatment).
```

## make/pkgs/python-cffi/Config.in
```kconfig
config FREETZ_PACKAGE_PYTHON_CFFI
	bool "Cffi 1.15.1"
	depends on FREETZ_PACKAGE_PYTHON
	default n
	help
		A Foreign Function Interface package for calling C libraries from Python.
```

## make/pkgs/python-mysql-connector/Config.in
```kconfig
config FREETZ_PACKAGE_PYTHON_MYSQL_CONNECTOR
	bool "mysql-connector 8.0.21 - DEPRECATED"
	depends on FREETZ_PACKAGE_PYTHON
	default n
	help
		Python MySQL Connector.
```

## make/pkgs/python-pycrypto/Config.in
```kconfig
config FREETZ_PACKAGE_PYTHON_PYCRYPTO
	bool "PyCrypto 2.7a1 - DEPRECATED"
	depends on FREETZ_PACKAGE_PYTHON
	depends on !FREETZ_PACKAGE_PYTHON_PYCRYPTODOME
	select FREETZ_LIB_libpython2 if !FREETZ_PACKAGE_PYTHON_STATIC
	select FREETZ_LIB_libgmp
	default n
	help
		A collection of both secure hash functions (such as MD5 and SHA),
		and various encryption algorithms (AES, DES, IDEA, RSA, ElGamal, etc.).

if FREETZ_PACKAGE_PYTHON_PYCRYPTO

	comment "PyCrypto 2.x is unmaintained, obsolete, and contains"
	comment "security vulnerabilities - use PyCryptodome instead!"

endif # FREETZ_PACKAGE_PYTHON_PYCRYPTO
```

## make/pkgs/radvd/Config.in
```kconfig
comment "radvd (not available, needs IPv6 support of the kernel)"
	depends on !FREETZ_TARGET_IPV6_SUPPORT

menuconfig FREETZ_PACKAGE_RADVD
	bool "radvd 1.9.3/2.21"
	depends on FREETZ_TARGET_IPV6_SUPPORT
	select FREETZ_BUSYBOX_IP
	default n
	help
		The "router advertisement daemon" (radvd) is used for host autoconfiguration in ipv6 networks.

if FREETZ_PACKAGE_RADVD

	choice
		prompt "Version"
			default FREETZ_PACKAGE_RADVD_VERSION_CURRENT

		config FREETZ_PACKAGE_RADVD_VERSION_ABANDON
			bool "1.9.3"
			depends on FREETZ_KERNEL_VERSION_2_6_19_MAX || FREETZ_TARGET_UCLIBC_0
			select FREETZ_LIB_libdaemon

		config FREETZ_PACKAGE_RADVD_VERSION_CURRENT
			bool "2.21"
			depends on !(FREETZ_KERNEL_VERSION_2_6_19_MAX || FREETZ_TARGET_UCLIBC_0)

	endchoice

endif # FREETZ_PACKAGE_RADVD
```

## make/pkgs/rsync/Config.in
```kconfig
config FREETZ_PACKAGE_RSYNC
	bool "rsync 3.3.0"
	select FREETZ_LIB_libpopt
	select FREETZ_LIB_libz
	default n
	help
		rsync is an open source utility that provides fast incremental
		file transfer.

if FREETZ_PACKAGE_RSYNC

	config FREETZ_PACKAGE_RSYNC_REMOVE_WEBIF
		bool "remove webinterface"
		default n
		help
			This option removes the webinterface

endif # FREETZ_PACKAGE_RSYNC
```

## make/pkgs/rtmpdump/Config.in
```kconfig
config FREETZ_PACKAGE_RTMPDUMP
	bool "RTMPDump 2.4-git (binary only) - DEPRECATED"
	select FREETZ_PACKAGE_RTMPDUMP_rtmpdump
	help
		rtmpdump is a toolkit for RTMP streams. All forms of RTMP are supported,
		including rtmp://, rtmpt://, rtmpe://, rtmpte://, and rtmps://.

if FREETZ_PACKAGE_RTMPDUMP

	config FREETZ_PACKAGE_RTMPDUMP_WITH_SSL
		bool "with SSL support"
		select FREETZ_LIB_libpolarssl13
		select FREETZ_LIB_libz

	config FREETZ_PACKAGE_RTMPDUMP_rtmpdump
		bool "rtmpdump"
		default y
		help
			RTMP streaming media client

	config FREETZ_PACKAGE_RTMPDUMP_rtmpgw
		bool "rtmpgw"
		select FREETZ_LIB_libpthread if FREETZ_TARGET_UCLIBC_HAS_multiple_libs
		help
			RTMP streaming media gateway

endif # FREETZ_PACKAGE_RTMPDUMP
```

## make/pkgs/sfk/Config.in
```kconfig
config FREETZ_PACKAGE_SFK
	bool "SFK 2.0.0.3"
	depends on ! (FREETZ_TARGET_UCLIBC_0_9_28 || FREETZ_TARGET_UCLIBC_0_9_29)
	select FREETZ_LIB_STDCXXLIB if ! FREETZ_PACKAGE_SFK_STATIC
#	select FREETZ_LIB_STDCXXLIB_WITH_WCHAR
	default n
	help
		Swiss File Knife - A Command Line Tools Collection

		This packages provides the freeware version of SFK,
		see http://stahlworks.com/dev/swiss-file-knife.html
		for further information

config FREETZ_PACKAGE_SFK_STATIC
	bool "Link statically"
	depends on FREETZ_PACKAGE_SFK
	default n
	help
		Causes all libraries SFK depends on to be linked in statically
```

## make/pkgs/siproxd/Config.in
```kconfig
config FREETZ_PACKAGE_SIPROXD
	bool "siproxd 0.8.1 - DEPRECATED"
	default n
	select FREETZ_LIB_libpthread  if FREETZ_TARGET_UCLIBC_HAS_multiple_libs
	select FREETZ_LIB_libdl       if FREETZ_TARGET_UCLIBC_HAS_multiple_libs
	select FREETZ_LIB_libltdl
	select FREETZ_LIB_libosip2
	help
		Siproxd is a proxy/masquerading daemon for the SIP protocol.
		See http://siproxd.sourceforge.net for more information.

if FREETZ_PACKAGE_SIPROXD

	config FREETZ_PACKAGE_SIPROXD_PLUGIN_DEFAULTTARGET
		bool "include defaulttarget plugin"
		default n

	config FREETZ_PACKAGE_SIPROXD_PLUGIN_FIX_BOGUS_VIA
		bool "include fix_bogus_via plugin"
		default n

	config FREETZ_PACKAGE_SIPROXD_PLUGIN_LOGCALL
		bool "include logcall plugin"
		default n

	config FREETZ_PACKAGE_SIPROXD_PLUGIN_PREFIX
		bool "include prefix plugin"
		default n

	config FREETZ_PACKAGE_SIPROXD_PLUGIN_REGEX
		bool "include regex plugin"
		default n

	config FREETZ_PACKAGE_SIPROXD_PLUGIN_SHORTDIAL
		bool "include shortdial plugin"
		default n

	config FREETZ_PACKAGE_SIPROXD_PLUGIN_STUN
		bool "include stun plugin"
		default n

	config FREETZ_PACKAGE_SIPROXD_PLUGIN_DEMO
		bool "include demo plugin"
		default n
		help
			include demo plugin (only for demo purposes)

endif # FREETZ_PACKAGE_SIPROXD
```

## make/pkgs/slang/Config.in
```kconfig
config FREETZ_PACKAGE_SLANG
	bool "S-Lang 2.3.3 (binary only)"
	select FREETZ_LIB_libslang
	default n
	help
		S-Lang is a powerful interpreted language that may be embedded
		into an application to make the application extensible.

		Note: at the moment this options causes only libslang to be included
		in the image, i.e. S-Lang shell support is disabled.

if FREETZ_PACKAGE_SLANG

	config FREETZ_PACKAGE_SLANG_MODULES
		bool "include shared modules"
		select FREETZ_LIB_libiconv if FREETZ_TARGET_UCLIBC_0_9_28
		select FREETZ_LIB_libpcre
		select FREETZ_LIB_libz
		default n
		help
			This option causes shared modules to be included in the image.

endif # FREETZ_PACKAGE_SLANG
```

## make/pkgs/sqlite/Config.in
```kconfig
config FREETZ_PACKAGE_SQLITE
	bool "SQLite 3.40.1/3.46.1 (binary only)"
	select FREETZ_LIB_libsqlite3
	default n
	help
		SQLite is a small C library that implements a self-contained, embeddable,
		zero-configuration SQL database engine.

if FREETZ_PACKAGE_SQLITE

	choice
		prompt "Version"
			default FREETZ_PACKAGE_SQLITE_VERSION_CURRENT

		config FREETZ_PACKAGE_SQLITE_VERSION_ABANDON
			bool "3.40.1"
			depends on (FREETZ_TARGET_UCLIBC_0_9_28 || FREETZ_TARGET_UCLIBC_0_9_29)

		config FREETZ_PACKAGE_SQLITE_VERSION_CURRENT
			bool "3.46.1"
			depends on !(FREETZ_TARGET_UCLIBC_0_9_28 || FREETZ_TARGET_UCLIBC_0_9_29)

	endchoice

	config FREETZ_PACKAGE_SQLITE_WITH_READLINE
		bool "build with readline support"
		select FREETZ_LIB_libreadline
		select FREETZ_LIB_libncurses
		default n
		help
			This option causes command line client to be built with readline and history support.

endif # FREETZ_PACKAGE_SQLITE
```

## make/pkgs/sslh/Config.in
```kconfig
config FREETZ_PACKAGE_SSLH
	bool "sslh 2.2.4/2.3.1"
	default n
	depends on FREETZ_KERNEL_VERSION_2_6_28_MIN
	select FREETZ_LIB_libconfig
	select FREETZ_LIB_libpcre2
	help
		sslh accepts HTTPS, SSH and OpenVPN connections on the same port.
		This makes it possible to connect to an SSH server or an OpenVPN
		on port 443 (e.g. from inside a corporate firewall, which almost
		never block port 443) while still serving HTTPS on that port.

if FREETZ_PACKAGE_SSLH

	choice
		prompt "Version"
			default FREETZ_PACKAGE_SSLH_VERSION_CURRENT

		config FREETZ_PACKAGE_SSLH_VERSION_ABANDON
			bool "2.2.4"
			depends on FREETZ_AVM_GCC_5_MAX

		config FREETZ_PACKAGE_SSLH_VERSION_CURRENT
			bool "2.3.1"
			depends on !FREETZ_AVM_GCC_5_MAX

	endchoice

endif # FREETZ_PACKAGE_SSLH
```

## make/pkgs/tiff/Config.in
```kconfig
config FREETZ_PACKAGE_TIFF
	bool "TIFF utils 4.0.7 (binary only) - DEPRECATED"
	default n
	help
		Various utilities to manupulate/convert images to/from TIFF format.

if FREETZ_PACKAGE_TIFF

	config FREETZ_PACKAGE_TIFF_fax2ps
		select FREETZ_LIB_libtiff
		bool "fax2ps"

	config FREETZ_PACKAGE_TIFF_fax2tiff
		select FREETZ_LIB_libtiff
		bool "fax2tiff"

	config FREETZ_PACKAGE_TIFF_ppm2tiff
		select FREETZ_LIB_libtiff
		bool "ppm2tiff"

	config FREETZ_PACKAGE_TIFF_raw2tiff
		select FREETZ_LIB_libtiff
		bool "raw2tiff"

	config FREETZ_PACKAGE_TIFF_tiff2bw
		select FREETZ_LIB_libtiff
		bool "tiff2bw"

	config FREETZ_PACKAGE_TIFF_tiff2pdf
		select FREETZ_LIB_libtiff
		bool "tiff2pdf"

	config FREETZ_PACKAGE_TIFF_tiff2ps
		select FREETZ_LIB_libtiff
		bool "tiff2ps"

	config FREETZ_PACKAGE_TIFF_tiffinfo
		select FREETZ_LIB_libtiff
		bool "tiffinfo"

	config FREETZ_PACKAGE_TIFF_tiffsplit
		select FREETZ_LIB_libtiff
		bool "tiffsplit"

endif # FREETZ_PACKAGE_TIFF
```

## make/pkgs/tmux/Config.in
```kconfig
config FREETZ_PACKAGE_TMUX
	bool "tmux 3.6a (binary only)"
	depends on !(FREETZ_TARGET_UCLIBC_0_9_28 || FREETZ_TARGET_UCLIBC_0_9_29)
	select FREETZ_LIB_libutil     if ! FREETZ_PACKAGE_TMUX_STATIC && FREETZ_TARGET_UCLIBC_HAS_multiple_libs
	select FREETZ_LIB_libncurses  if ! FREETZ_PACKAGE_TMUX_STATIC
	select FREETZ_LIB_libevent    if ! FREETZ_PACKAGE_TMUX_STATIC
	select FREETZ_SHARE_terminfo
	default n
	help
		tmux, a BSD-licensed alternative to GNU screen.
		Uses ncurses.

if FREETZ_PACKAGE_TMUX

	config FREETZ_PACKAGE_TMUX_STATIC
		bool "Link statically"
		default n
		help
			TMUX will be linked statically to run without libraries

endif # FREETZ_PACKAGE_TMUX
```

## make/pkgs/umurmur/Config.in
```kconfig
config FREETZ_PACKAGE_UMURMUR
	bool "uMurmur 0.2.20/0.3.1"
	depends on FREETZ_TARGET_IPV6_SUPPORT
	select FREETZ_LIB_libconfig
	select FREETZ_LIB_libprotobuf_c
	default n
	help
		umurmur is a minimalistic Mumble server primarily
		targeted to run on routers using less resources.
		It targets to fill the needs of a pretty small group
		of users communicating, which in part originates from
		the other goal of working well on a small system with
		a limited CPU and limited amount of disk space. It also
		aims to minimize writing to the disk since these kinds
		of systems usually only has a flash memory for disk.
		umurmur supports a subset of the features of Murmur.
		https://github.com/umurmur/umurmur

if FREETZ_PACKAGE_UMURMUR

	choice
		prompt "Version"
			default FREETZ_PACKAGE_UMURMUR_VERSION_CURRENT

		config FREETZ_PACKAGE_UMURMUR_VERSION_ABANDON
			bool "0.2.20"
			help
				Needs Openssl 1.x or mbedTLS v2.x

		config FREETZ_PACKAGE_UMURMUR_VERSION_CURRENT
			bool "0.3.1"
			help
				Needs Openssl 3.x or mbedTLS v3.x

	endchoice

	comment "Required: Openssl 3.x or mbedTLS v3.x"
		depends on FREETZ_PACKAGE_UMURMUR_VERSION_CURRENT

	comment "Unsupported: Openssl 3.x or mbedTLS v3.x"
		depends on FREETZ_PACKAGE_UMURMUR_VERSION_ABANDON

	choice
		prompt "SSL library"
			default FREETZ_PACKAGE_UMURMUR_OPENSSL

		config FREETZ_PACKAGE_UMURMUR_OPENSSL
			bool "OpenSSL"
			select FREETZ_LIB_libcrypto
			select FREETZ_LIB_libcrypto_WITH_EC
			select FREETZ_LIB_libssl

		config FREETZ_PACKAGE_UMURMUR_MBEDTLS
			bool "mbedTLS"
			depends on FREETZ_PACKAGE_UMURMUR_VERSION_ABANDON
			select FREETZ_LIB_libmbedcrypto
			select FREETZ_LIB_libmbedcrypto_WITH_GENRSA
			select FREETZ_LIB_libmbedtls
			select FREETZ_LIB_libmbedx509

	endchoice

endif # FREETZ_PACKAGE_UMURMUR
```

## make/pkgs/unrar/Config.in
```kconfig
config FREETZ_PACKAGE_UNRAR
	bool "UnRAR 6.1.7/6.2.12/7.0.9 (binary only)"
	select FREETZ_STDCXXLIB_FORCE_GNULIBSTDCXX
	select FREETZ_LIB_STDCXXLIB if ! FREETZ_PACKAGE_UNRAR_STATIC
	default n
	help
		Unarchiver for .rar files

if FREETZ_PACKAGE_UNRAR


	choice
		prompt "Version"
			default FREETZ_PACKAGE_UNRAR_VERSION_70

		config FREETZ_PACKAGE_UNRAR_VERSION_61
			bool "6.1.7"
			depends on FREETZ_TARGET_GCC_4_8_MAX

		config FREETZ_PACKAGE_UNRAR_VERSION_62
			bool "6.2.12"
			depends on FREETZ_TARGET_GCC_5_5_MIN

		config FREETZ_PACKAGE_UNRAR_VERSION_70
			bool "7.0.9"
			depends on FREETZ_TARGET_GCC_8_MIN

	endchoice

	config FREETZ_PACKAGE_UNRAR_STATIC
		bool "Link statically"
		depends on FREETZ_PACKAGE_UNRAR
		default n
		help
			Causes all libraries unrar depends on to be linked in statically

endif # FREETZ_PACKAGE_UNRAR
```

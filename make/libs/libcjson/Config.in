## make/libs/libcjson/Config.in
```kconfig
config FREETZ_LIB_libcjson
	bool "libcjson (libcjson.so)"
	default n
	help
		Ultralightweight JSON parser in ANSI C.
```

## make/libs/libctlmgr/Config.in
```kconfig
config FREETZ_LIB_libctlmgr
	bool "libctlmgr (libctlmgr.so)"
	depends on FREETZ_AVM_HAS_AVMCTLMGR_PRELOAD
	select FREETZ_LIB_libctlmgr_WITH_CHMOD   if FREETZ_AVM_VERSION_07_0X_MIN
	select FREETZ_LIB_libctlmgr_WITH_RENAME  if FREETZ_AVM_VERSION_07_1X_MAX && FREETZ_AVM_HAS_USB_HOST
	default n
	help
		This is Freetz compatibility library which overwrites
		functions of AVM's libraries, e.g. write_etc_passwd.

if FREETZ_LIB_libctlmgr

	config FREETZ_LIB_libctlmgr_WITH_DEBUG
		bool "With DEBUG - DEVELOPER"
		depends on FREETZ_SHOW_DEVELOPER
		default n
		help
			Show some debug output on console.
			Do not enable it if you dont know a reason.

	config FREETZ_LIB_libctlmgr_WITH_CHMOD
		bool "With CHMOD"
		depends on FREETZ_AVM_VERSION_07_0X_MIN
		default n
		help
			Alters chmod() for /var/tmp directory.
			Used to keep filesystem permissions.

	config FREETZ_LIB_libctlmgr_WITH_RENAME
		bool "With RENAME"
		depends on FREETZ_AVM_VERSION_07_1X_MAX && FREETZ_AVM_HAS_USB_HOST
		default n
		help
			Alters rename() for /etc/passwd file.
			Used to keep freetz users.

endif # FREETZ_LIB_libctlmgr
```

## make/libs/libdeflate/Config.in
```kconfig
config FREETZ_LIB_libdeflate
	bool "libdeflate (libdeflate.so)"
	depends on FREETZ_TARGET_GCC_5_MIN
	default n
	help
		Heavily optimized library for DEFLATE/zlib/gzip compression and decompression
```

## make/libs/libxml2/Config.in
```kconfig
config FREETZ_LIB_libxml2
	bool "libxml2 (libxml2.so)"
	select FREETZ_LIB_libiconv    if FREETZ_TARGET_UCLIBC_0_9_28
	select FREETZ_LIB_libpthread  if FREETZ_TARGET_UCLIBC_HAS_multiple_libs
	select FREETZ_LIB_libm        if FREETZ_TARGET_UCLIBC_HAS_multiple_libs
	select FREETZ_LIB_libz
	default n
	help
		XML toolkit from the GNOME project

if FREETZ_LIB_libxml2

	config FREETZ_LIB_libxml2_WITH_HTML
		bool "Build with HTML parser"
		default n
		help
			Adds html parsing capability to libxml2. This increases the size of
			libxml2 by 121kB. Html parsing is required to build libxslt.

	config FREETZ_LIB_libxml2_WITH_RELAXNG
		bool "Build with RELAX NG support"
		default n
		help
			Enables RELAX NG schema validation support.
			RELAX NG is an alternative to XML Schema for validating XML documents.
			This increases the size of libxml2 by 96kB.

endif # FREETZ_LIB_libxml2
```

## make/libs/libzip/Config.in
```kconfig
config FREETZ_LIB_libzip
	bool "libzip (libzip.so)"
	depends on !(FREETZ_TARGET_UCLIBC_0_9_28 || FREETZ_TARGET_UCLIBC_0_9_29)
	select FREETZ_LIB_libz
	default n
	help
		libzip is a C library for reading, creating, and modifying zip archives.
		It supports encryption, compression, and Zip64 extensions.
```

## make/libs/mbedtls/Config.in
```kconfig
config FREETZ_LIB_libmbedcrypto
	bool "mbedCrypto (libmbedcrypto.so)"
	default n

	config FREETZ_LIB_libmbedcrypto_WITH_BLOWFISH
		bool "With Blowfish cipher" if FREETZ_LIB_libmbedcrypto
		depends on FREETZ_MBEDTLS_VERSION_228_MAX
		default n
		help
			Enables support for the Blowfish block cipher.

	config FREETZ_LIB_libmbedcrypto_WITH_GENRSA
		bool "With RSA prime-number generation" if FREETZ_LIB_libmbedcrypto
		default n
		help
			Enables the RSA prime-number generation code.

config FREETZ_LIB_libmbedtls
	bool "mbedTLS (libmbedtls.so)"
	default n

config FREETZ_LIB_libmbedx509
	bool "mbedX.509 (libmbedx509.so)"
	default n

choice
	prompt "MbedTLS version"
	default FREETZ_MBEDTLS_VERSION_306
	default FREETZ_MBEDTLS_VERSION_228
	default FREETZ_MBEDTLS_VERSION_207

	config FREETZ_MBEDTLS_VERSION_207
		bool "2.7 - DEPRECATED"
		depends on  FREETZ_TARGET_GCC_4_MAX && !FREETZ_SYSTEM_TYPE_PUMA6

	config FREETZ_MBEDTLS_VERSION_228
		bool "2.28 - DEPRECATED"
		depends on !FREETZ_TARGET_GCC_4_MAX ||  FREETZ_SYSTEM_TYPE_PUMA6

	config FREETZ_MBEDTLS_VERSION_306
		bool "3.6"
		depends on !FREETZ_TARGET_GCC_4_MAX

endchoice # "MbedTLS version"

config FREETZ_MBEDTLS_SHORT_VERSION
	string
	default "2.7"   if FREETZ_MBEDTLS_VERSION_207
	default "2.28"  if FREETZ_MBEDTLS_VERSION_228
	default "3.6"   if FREETZ_MBEDTLS_VERSION_306


config FREETZ_MBEDTLS_VERSION_207_MIN
	def_bool y
	depends on \
		FREETZ_MBEDTLS_VERSION_207 || \
		FREETZ_MBEDTLS_VERSION_228_MIN

config FREETZ_MBEDTLS_VERSION_228_MIN
	def_bool y
	depends on \
		FREETZ_MBEDTLS_VERSION_228 || \
		FREETZ_MBEDTLS_VERSION_306_MIN

config FREETZ_MBEDTLS_VERSION_306_MIN
	def_bool y
	depends on \
		FREETZ_MBEDTLS_VERSION_306


config FREETZ_MBEDTLS_VERSION_207_MAX
	def_bool y
	depends on \
		FREETZ_MBEDTLS_VERSION_207

config FREETZ_MBEDTLS_VERSION_228_MAX
	def_bool y
	depends on \
		FREETZ_MBEDTLS_VERSION_228 || \
		FREETZ_MBEDTLS_VERSION_207_MAX

config FREETZ_MBEDTLS_VERSION_306_MAX
	def_bool y
	depends on \
		FREETZ_MBEDTLS_VERSION_306 || \
		FREETZ_MBEDTLS_VERSION_228_MAX
```

## make/libs/pcre/Config.in
```kconfig
config FREETZ_LIB_libpcre
	bool "libpcre (libpcre.so) - DEPRECATED"
	default n
	help
		A Perl Compatible Regular Expression library

config FREETZ_LIB_libpcreposix
	bool "libpcreposix (libpcreposix.so) - DEPRECATED"
	select FREETZ_LIB_libpcre
	default n
	help
		A POSIX wrapper interface to the Perl Compatible Regular Expression
		library
```

## make/libs/pcre2/Config.in
```kconfig
config FREETZ_LIB_libpcre2
	bool "libpcre2 (libpcre2-8.so)"
	default n
	help
		A Perl Compatible Regular Expression library

if FREETZ_LIB_libpcre2

	config FREETZ_LIB_libpcre2_WITH_JIT
		bool "Enable JIT compilation support"
		depends on !FREETZ_KERNEL_VERSION_2_6_39_3  # in execute_cpu_id() cpuid() is called with "inconsistent operand constraints in an 'asm'"
		default n
		help
			Enable Just-In-Time (JIT) compilation support for faster regex execution.
			
			JIT compiles regular expressions to native machine code for better performance,
			which is beneficial for applications like PHP that use regex extensively.
			
			Size impact: Adds approximately 100-150 KB to libpcre2-8.so

endif # FREETZ_LIB_libpcre2

config FREETZ_LIB_libpcre2_posix
	bool "libpcre2-posix (libpcre2-posix.so)"
	select FREETZ_LIB_libpcre2
	default n
	help
		A POSIX wrapper interface to the Perl Compatible Regular Expression
		library
```

## make/libs/uclibcxx/Config.in
```kconfig
config FREETZ_LIB_libuClibcxx
	bool "uClibc++ (libuClibc++.so.0.2.6)"
	default n
	help
		An implementation of the Standard C++ Library optimized for embedded systems.

	config FREETZ_LIB_libuClibcxx_WITH_WCHAR
		bool "enable wchar support" if FREETZ_LIB_libuClibcxx
		default n
		help
			Enables wchar-support in uClibc++.
```

## make/pkgs/avm-rules/Config.in
```kconfig
config FREETZ_PACKAGE_AVM_RULES
	bool "AVM-rules - DEVELOPER"
	depends on FREETZ_AVM_HAS_DSLD
	depends on !FREETZ_REMOVE_DSLD
	depends on FREETZ_AVM_VERSION_08_0X_MIN && FREETZ_REAL_DEVELOPER_ONLY
	default n
	help
		For FritzOS since v8.0x only.
		Configuration of port forwardings to the FritzBox itself
		by using voip_forwardrules.
		Warning:
		This package changes the ar7.cfg. On syntax errors AVM
		will reset the whole file to default, including default
		password and default ip. Backup you config before!
```

## make/pkgs/bird/Config.in
```kconfig
config FREETZ_PACKAGE_BIRD
	bool "BIRD 1.6.8/2.17.1"
	default n
	help
		The BIRD Internet Routing Daemon

if FREETZ_PACKAGE_BIRD

	choice
		prompt "Version"
			default FREETZ_PACKAGE_BIRD_VERSION_ABANDON

		config FREETZ_PACKAGE_BIRD_VERSION_ABANDON
			bool "1.6.8"

		config FREETZ_PACKAGE_BIRD_VERSION_CURRENT
			bool "2.17.1"
			select FREETZ_PACKAGE_BIRD_REMOVE_WEBIF
			depends on FREETZ_KERNEL_VERSION_4_1_MIN
			help
				The Web interface is disabled because
				of the not compatible option syntax.

	endchoice

	config FREETZ_PACKAGE_BIRD_DEBUG
		bool "Debugging code (recommended)"
		default y
		help
			Enables additional debugging code. This is highly recommended.
			Increases binary size by around 3 KB.

	config FREETZ_PACKAGE_BIRDC
		bool "birdc"
		select FREETZ_LIB_libncurses
		select FREETZ_LIB_libreadline
		select FREETZ_LIB_libhistory
		default n
		help
			birdc (command-line interface for bird)

	config FREETZ_PACKAGE_BIRD_REMOVE_WEBIF
		bool "remove webinterface"
		default n
		help
			This option removes the webinterface

endif # FREETZ_PACKAGE_BIRD
```

## make/pkgs/br2684ctl/Config.in
```kconfig
config FREETZ_PACKAGE_BR2684CTL
	bool "br2684ctl (binary only) - DEPRECATED"
	select FREETZ_LIB_libatm
	depends on FREETZ_AVM_VERSION_04_XX_MAX
	default n
	help
		ATM Ethernet bridging configuration utility
```

## make/pkgs/bvi/Config.in
```kconfig
config FREETZ_PACKAGE_BVI
	bool "bvi 1.5.0 (binary only)"
	default n
	select FREETZ_LIB_libncurses
	select FREETZ_PACKAGE_BVI_bvi if !FREETZ_PACKAGE_BVI_bmore
	help
		A hex editor/viewer for binary files

if FREETZ_PACKAGE_BVI

	config FREETZ_PACKAGE_BVI_bvi
		bool "bvi/bview"
		default y

	config FREETZ_PACKAGE_BVI_bmore
		bool "bmore"
		default n

endif # FREETZ_PACKAGE_BVI
```

## make/pkgs/dante/Config.in
```kconfig
config FREETZ_PACKAGE_DANTE
	bool "Dante 1.4.4"
	depends on FREETZ_TARGET_IPV6_SUPPORT
	select FREETZ_LIB_libcrypt  if FREETZ_TARGET_UCLIBC_HAS_multiple_libs
	select FREETZ_LIB_libdl     if FREETZ_TARGET_UCLIBC_HAS_multiple_libs
	default n
	help
		A free SOCKS server
```

## make/pkgs/dosfstools/Config.in
```kconfig
config FREETZ_PACKAGE_DOSFSTOOLS
	bool "dosfstools 3.0.28 (binary only) - DEPRECATED"
	select FREETZ_LIB_libiconv if FREETZ_TARGET_UCLIBC_0_9_28
	default n
	help
		utilities to create, check and label MS-DOS FAT filesystems

if FREETZ_PACKAGE_DOSFSTOOLS

	config FREETZ_PACKAGE_DOSFSTOOLS_fsck_fat
		bool "fsck.fat"
		default n
		help
			This option enables the checking utility for MS-DOS FAT filesystems

	config FREETZ_PACKAGE_DOSFSTOOLS_fatlabel
		bool "fatlabel"
		default n
		help
			This option enables labeling utility for MS-DOS FAT filesystems

	config FREETZ_PACKAGE_DOSFSTOOLS_mkfs_fat
		bool "mkfs.fat"
		default n
		help
			This option enables the creation utility for MS-DOS FAT filesystems

endif # FREETZ_PACKAGE_DOSFSTOOLS
```

## make/pkgs/ghostscript-fonts/Config.in
```kconfig
config FREETZ_PACKAGE_GHOSTSCRIPT_FONTS
	bool "Ghostscript fonts 8.11 (binary only) - DEPRECATED"
	default n
	help
		This package provides the Ghostscript fonts.
```

## make/pkgs/gnu-make/Config.in
```kconfig
config FREETZ_PACKAGE_GNU_MAKE
	bool "Make 4.2.1/4.4.1 (binary only)"
	default n
	help
		Make is a tool which controls the generation of executables and
		other non-source files of a program from the program's source files.

if FREETZ_PACKAGE_GNU_MAKE

	choice
		prompt "Version"
			default FREETZ_PACKAGE_GNU_MAKE_VERSION_CURRENT

		config FREETZ_PACKAGE_GNU_MAKE_VERSION_ABANDON
			bool "4.2.1"
			depends on  (FREETZ_TARGET_UCLIBC_0_9_28 || FREETZ_TARGET_UCLIBC_0_9_29)

		config FREETZ_PACKAGE_GNU_MAKE_VERSION_CURRENT
			bool "4.4.1"
			depends on !(FREETZ_TARGET_UCLIBC_0_9_28 || FREETZ_TARGET_UCLIBC_0_9_29)

	endchoice

endif # FREETZ_PACKAGE_GNU_MAKE
```

## make/pkgs/hostapd_cli/Config.in
```kconfig
config FREETZ_PACKAGE_HOSTAPD_CLI
	bool "hostapd_cli 2.7/2.10/2.11 (binary only) - DEVELOPER"
	depends on FREETZ_SHOW_DEVELOPER
	depends on FREETZ_AVM_HAS_HOSTAPD
	default n
	help
		Command line client for hostapd control interface.
		Useful to send BSS Transition Management (802.11v) and
		Neighbor Report (802.11k) commands to the running daemon.
		See https://github.com/Freetz-NG/freetz-ng/discussions/1295

if FREETZ_PACKAGE_HOSTAPD_CLI

	choice
		prompt "Version"
			default FREETZ_PACKAGE_HOSTAPD_CLI_VERSION_2_11

		config FREETZ_PACKAGE_HOSTAPD_CLI_VERSION_2_7
			bool "2.7"
			depends on \
				FREETZ_AVM_HAS_HOSTAPD_VERSION_0_5_9 || \
				FREETZ_AVM_HAS_HOSTAPD_VERSION_2_0 || \
				FREETZ_AVM_HAS_HOSTAPD_VERSION_2_10 || \
				FREETZ_AVM_HAS_HOSTAPD_VERSION_2_5 || \
				FREETZ_AVM_HAS_HOSTAPD_VERSION_2_7

		config FREETZ_PACKAGE_HOSTAPD_CLI_VERSION_2_10
			bool "2.10"
			depends on \
				FREETZ_AVM_HAS_HOSTAPD_VERSION_2_8 || \
				FREETZ_AVM_HAS_HOSTAPD_VERSION_2_9 || \
				FREETZ_AVM_HAS_HOSTAPD_VERSION_2_10

		config FREETZ_PACKAGE_HOSTAPD_CLI_VERSION_2_11
			bool "2.11"
			depends on !( \
				FREETZ_AVM_HAS_HOSTAPD_VERSION_0_5_9 || \
				FREETZ_AVM_HAS_HOSTAPD_VERSION_2_0 || \
				FREETZ_AVM_HAS_HOSTAPD_VERSION_2_10 || \
				FREETZ_AVM_HAS_HOSTAPD_VERSION_2_5 || \
				FREETZ_AVM_HAS_HOSTAPD_VERSION_2_7 || \
				FREETZ_AVM_HAS_HOSTAPD_VERSION_2_8 || \
				FREETZ_AVM_HAS_HOSTAPD_VERSION_2_9 || \
				FREETZ_AVM_HAS_HOSTAPD_VERSION_2_10 \
				)

	endchoice

	comment "WARNING: The device uses a different version of hostapd"
		depends on FREETZ_PACKAGE_HOSTAPD_CLI_VERSION_2_11 && !FREETZ_AVM_HAS_HOSTAPD_VERSION_2_11

endif # FREETZ_PACKAGE_HOSTAPD_CLI
```

## make/pkgs/httptunnel/Config.in
```kconfig
config FREETZ_PACKAGE_HTTPTUNNEL
	bool "httptunnel 3.3 (binary only) - DEPRECATED"
	default n
	help
		httptunnel is a utility that provides a HTTP tunnel server.
```

## make/pkgs/infozip/Config.in
```kconfig
config FREETZ_PACKAGE_INFOZIP
	bool "Info-ZIP 3.0 (binary only) - DEPRECATED"
	default n
	help
		Info-ZIP's purpose is to provide free, portable, high-quality versions
		of the Zip compressor-archiver utilities that are compatible with the
		the DOS-based PKZIP by PKWARE, Inc.
```

## make/pkgs/iptables-cgi/Config.in
```kconfig
config FREETZ_PACKAGE_IPTABLES_CGI
	bool "Iptables-CGI - DEPRECATED"
	depends on FREETZ_PACKAGE_IPTABLES
	select FREETZ_PACKAGE_IPTABLES_STANDARD_MODULES
	select FREETZ_PACKAGE_IPTABLES_SAVE_RESTORE
	default n
```

## make/pkgs/iptables-ng/Config.in
```kconfig
config FREETZ_PACKAGE_IPTABLES_NG
	bool "Iptables-NG - EXPERIMENTAL"
	depends on FREETZ_TARGET_IPV6_SUPPORT
	depends on FREETZ_PACKAGE_IPTABLES
	select FREETZ_REMOVE_DSLD if FREETZ_AVM_HAS_DSLD
	select FREETZ_PACKAGE_IPTABLES_SAVE_RESTORE
	default n
	help
		Advanced iptables/ip6tables management page with dynamic table
		and module capability detection, plus save/restore controls.

		Runtime status (started/stopped) is independent from startup mode
		(automatic/manual). Startup mode only controls boot behavior.

		See docs/make/iptables-ng.md for more hints.

		This package forces removing of dsld if available!
```

## make/pkgs/iputils/Config.in
```kconfig
config FREETZ_PACKAGE_IPUTILS
	bool "iputils' traceroute6 s20071127 (binary only) - DEPRECATED"
	depends on FREETZ_TARGET_IPV6_SUPPORT
	default n
```

## make/pkgs/juis_bearer/Config.in
```kconfig
config FREETZ_PACKAGE_JUIS_BEARER
	bool "juis_bearer 1.0"
	select FREETZ_BUSYBOX_BASE64
	select FREETZ_PACKAGE_CURL
	select FREETZ_PACKAGE_CURL_SELECT_SSL
	select FREETZ_PACKAGE_OPENSSL
	default n
	help
		This integrates the juis_bearer script from tools/ dir into the image.
		It is a bearer token handler of juis with avmzertifikate.

if FREETZ_PACKAGE_JUIS_BEARER

	config FREETZ_PACKAGE_JUIS_BEARER_WITH_DEBUG
		bool "Select debug tools"
		select FREETZ_PACKAGE_JQ
		select FREETZ_BUSYBOX_XXD
		default n
		help
			Selects jq and xxd for:
			 - kid handling
			 - signature validation
			Not needed for juis_check usage.

endif # FREETZ_PACKAGE_JUIS_BEARER
```

## make/pkgs/juis_check/Config.in
```kconfig
config FREETZ_PACKAGE_JUIS_CHECK
	bool "juis_check 1.4"
	select FREETZ_BUSYBOX_BASE64
	select FREETZ_BUSYBOX_HEXDUMP
	select FREETZ_BUSYBOX_NC
	select FREETZ_BUSYBOX_NC_110_COMPAT
	select FREETZ_BUSYBOX_SHUF
	default n
	help
		This integrates the juis_check script from tools/ dir into the image.
		It run 23 time faster (0,3sec vs 7sec) than other bloated
		implementations and needs only 4% of space (4kB vs 93kB).

if FREETZ_PACKAGE_JUIS_CHECK

	config FREETZ_PACKAGE_JUIS_CHECK_WITH_SSL
		bool "Enable https"
		select FREETZ_PACKAGE_CURL
		select FREETZ_PACKAGE_CURL_SELECT_SSL
		default n
		help
			This selects curl and uses it for encrypted https connections.

endif # FREETZ_PACKAGE_JUIS_CHECK
```
